## layers/meta-balena-jetson/conf/machine/atc3750-8m-agx-orin-64gb.conf
```bitbake
#@TYPE: Machine
#@NAME: Nexcom ATC3750-8M AGX Orin 64GB
#@DESCRIPTION: Nexcom ATC3750-8M with AGX Orin 64GB module
#

# Based on AGX Orin 64GB but with custom device tree for ATC3750-8M
TEGRA_BOARDSKU ?= "0005"
TEGRA_BUPGEN_SPECS ?= "fab=300;boardsku=0005;boardrev=;chipsku=00:00:00:D0;bup_type=bl \
                       fab=300;boardsku=0005;boardrev=;bup_type=kernel"

# Custom device tree for ATC3750-8M hardware
KERNEL_DEVICETREE ?= "tegra234-p3701-0005-atc3750-8M-base_ver.dtb"

# Use Nexcom-specific BCT files
TEGRA_FLASHVAR_BPFDTB_FILE ?= "tegra234-bpmp-3701-0005-3737-0000.dtb"
TEGRA_FLASHVAR_PMIC_CONFIG ?= "tegra234-mb1-bct-pmic-p3701-0005.dts"
TEGRA_FLASHVAR_WB0SDRAM_BCT ?= "tegra234-p3701-0005-wb0sdram-l4t.dts"

EMMC_BCT ?= "tegra234-p3701-0005-sdram-l4t.dts"

require conf/machine/include/agx-orin.inc

# Override plugin manager overlays for ATC3750-8M specific configuration
TEGRA_PLUGIN_MANAGER_OVERLAYS ?= "tegra234-p3737-0000+p3701-0000-dynamic.dtbo tegra234-carveouts.dtbo tegra-optee.dtbo"
```

## layers/meta-balena-jetson/conf/machine/nexcom-atc3750-6c-agx-orin-32gb.conf
```bitbake
#@TYPE: Machine
#@NAME: Nexcom ATC3750-6C AGX Orin 32GB
#@DESCRIPTION: Nexcom ATC3750-6C with AGX Orin 32GB module - requires Nexcom BSP patches
#

# ATC3750-6C 32GB variant configuration
TEGRA_BOARDSKU ?= "0004"

# Flash configuration for 32GB variant
TEGRA_BUPGEN_SPECS ?= "fab=A00;boardsku=0004;boardrev=;chipsku=00:00:00:D0;bup_type=bl \
                       fab=A00;boardsku=0004;boardrev=;bup_type=kernel"

# ATC3750-6C 32GB device tree
KERNEL_DEVICETREE ?= "tegra234-atc3750-6C+p3701-0004-orin.dtb"

# SKU-specific PMIC configuration
TEGRA_FLASHVAR_PMIC_CONFIG ?= "tegra234-mb1-bct-pmic-p3701-0004.dts"

# SKU-specific BPMP device tree
TEGRA_FLASHVAR_BPFDTB_FILE ?= "tegra234-bpmp-3701-0004-3737-0000.dtb"

# 32GB-specific SDRAM configuration
EMMC_BCT ?= "tegra234-p3701-0004-sdram-l4t.dts"
TEGRA_FLASHVAR_WB0SDRAM_BCT ?= "tegra234-p3701-0004-wb0sdram-l4t.dts"

# Include ATC3750-6C common configuration (replaces agx-orin.inc)
require conf/machine/include/atc3750-6c-orin.inc
require conf/machine/include/devkit-wifi.inc
```

## layers/meta-balena-jetson/conf/machine/nexcom-atc3750-8m-agx-orin-32gb.conf
```bitbake
#@TYPE: Machine
#@NAME: Nexcom ATC3750-8M AGX Orin 32GB
#@DESCRIPTION: Nexcom ATC3750-8M with AGX Orin 32GB module - requires Nexcom BSP patches
#

# ATC3750-8M 32GB variant configuration
TEGRA_BOARDSKU ?= "0004"

# Flash configuration for 32GB variant
TEGRA_BUPGEN_SPECS ?= "fab=A00;boardsku=0004;boardrev=;chipsku=00:00:00:D0;bup_type=bl \
                       fab=A00;boardsku=0004;boardrev=;bup_type=kernel"

# ATC3750-8M 32GB device tree
KERNEL_DEVICETREE ?= "tegra234-p3701-0004-atc3750-8M-base_ver.dtb"

# SKU-specific PMIC configuration
TEGRA_FLASHVAR_PMIC_CONFIG ?= "tegra234-mb1-bct-pmic-p3701-0005.dts"

# SKU-specific BPMP device tree
TEGRA_FLASHVAR_BPFDTB_FILE ?= "tegra234-bpmp-3701-0004-3737-0000.dtb"

# Include ATC3750-8M common configuration (replaces agx-orin.inc)
require conf/machine/include/atc3750-8m-orin.inc
require conf/machine/include/devkit-wifi.inc
```

## layers/meta-balena-jetson/conf/machine/nexcom-atc3750-8m-agx-orin-64gb.conf
```bitbake
#@TYPE: Machine
#@NAME: Nexcom ATC3750-8M AGX Orin 64GB
#@DESCRIPTION: Nexcom ATC3750-8M with AGX Orin 64GB module - requires Nexcom BSP patches
#

# ATC3750-8M 64GB variant configuration
TEGRA_BOARDSKU ?= "0005"

# Flash configuration for 64GB variant
TEGRA_BUPGEN_SPECS ?= "fab=A00;boardsku=0005;boardrev=;chipsku=00:00:00:D0;bup_type=bl \
                       fab=A00;boardsku=0005;boardrev=;bup_type=kernel"

# ATC3750-8M 64GB device tree
KERNEL_DEVICETREE ?= "tegra234-p3701-0005-atc3750-8M-base_ver.dtb"

# SKU-specific PMIC configuration
TEGRA_FLASHVAR_PMIC_CONFIG ?= "tegra234-mb1-bct-pmic-p3701-0005.dts"

# SKU-specific BPMP device tree
TEGRA_FLASHVAR_BPFDTB_FILE ?= "tegra234-bpmp-3701-0005-3737-0000.dtb"

# 64GB-specific SDRAM configuration
EMMC_BCT ?= "tegra234-p3701-0005-sdram-l4t.dts"
TEGRA_FLASHVAR_WB0SDRAM_BCT ?= "tegra234-p3701-0005-wb0sdram-l4t.dts"

# Include ATC3750-8M common configuration (replaces agx-orin.inc)
require conf/machine/include/atc3750-8m-orin.inc
require conf/machine/include/devkit-wifi.inc
```
